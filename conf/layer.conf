## conf/layer.conf
```bitbake
# We have a conf and classes directory, add to BBPATH
BBPATH .= ":${LAYERDIR}"

# We have recipes-* directories, add to BBFILES
BBFILES += "${LAYERDIR}/recipes-*/*/*.bb \
            ${LAYERDIR}/recipes-*/*/*.bbappend"

BBFILE_COLLECTIONS += "meta-video"
BBFILE_PATTERN_meta-video = "^${LAYERDIR}/"
BBFILE_PRIORITY_meta-video = "6"

LAYERDEPENDS_meta-video = "core"
LAYERSERIES_COMPAT_meta-video = "kirkstone"
```
